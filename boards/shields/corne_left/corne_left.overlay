/ {
    zephyr,display = &display0;
};

&spi1 {
    status = "okay";
    cs-gpios = <&gpio0 3 GPIO_ACTIVE_LOW>;  // Adjust GPIO pin as per your hardware
    display0: display@0 {
        compatible = "sharp,LS012B7DD01";
        label = "DISPLAY";
        reg = <0>;
        spi-max-frequency = <1000000>;
        width = <38>
        height = <184>;
        extcomin-gpios = <&gpio0 28 GPIO_ACTIVE_HIGH>;  // Adjust as needed
        clear-gpios = <&gpio0 2 GPIO_ACTIVE_LOW>;       // Adjust as needed
    };
};
